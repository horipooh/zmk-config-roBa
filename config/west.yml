## config/west.yml
```yaml
manifest:
  remotes:
    - name: zmkfirmware
      url-base: https://github.com/zmkfirmware
    - name: kumamuk-git
      url-base: https://github.com/kumamuk-git
    - name: caksoylar  # Widget用にこれを追加！
      url-base: https://github.com/caksoylar  
  projects:
    - name: zmk
      remote: zmkfirmware
      revision: v0.3-branch  # mainから安定版のv0.3に変更
      import: app/west.yml
    - name: zmk-pmw3610-driver
      remote: kumamuk-git
      revision: main         # kumamukさんのmainはv0.3ベースなのでOK
    - name: zmk-rgbled-widget # Widgetも忘れずに追加
      remote: caksoylar
      revision: v0.3-branch  # ここをv0.3-branchにするのが肝！
  self:
    path: config
```
